## base_external/configs/aesd_qemu_defconfig
```kconfig
BR2_aarch64=y
BR2_CCACHE=y
BR2_TARGET_GENERIC_ROOT_PASSWD="root"
BR2_PACKAGE_DROPBEAR=y
BR2_PACKAGE_DROPBEAR_DISABLE_REVERSEDNS=y
BR2_TARGET_ROOTFS_EXT2=y
BR2_TARGET_ROOTFS_EXT2_4=y
BR2_PACKAGE_AESD_ASSIGNMENTS=y
```
